// Arduino  私だけの電子オルゴール 減衰矩形波/減衰正弦波
// 2020.4.21 koyama@hirosaki-u.ac.jp
// 2021.2.24 esp32移植byでんたろう
#include "mymelo.h"
#define  Nc  256
#define BUFFER_LEN    (256)        // バッファサイズ

int  W[]={0,0,0,0,0,0,1,1,2,3,3,4,5,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0,0};

//original
//const char W[] PROGMEM={0,0,0,0,1,1,1,2,2,3,4,5,5,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0,0};
// 三角波(値:0～255, データ数:256)
//prog_uint8_t W[]={0,2,4,6,8,10,12,14,16,18,20,22,24,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4,2};
uint8_t x,y;

#define extSW 34
#define Bzz1  25
#define Bzz2  26

#define CNT 8000000/256*0.5/8*120/TEMPO // テンポ120の四分音符(長さ8)を0.5秒とする
uint16_t cntr=CNT;                    // 32us*(1953*120/Tempo)=62.5ms
uint16_t p1=0, p2=0, p3=0;            // 楽譜part1～part3のポインタ(初期値は先頭)
uint8_t len1=8, len2=8, len3=8;       // 初期ディレイ(62.5ms*8=.5s)
uint8_t decayTimer=0;                 // 32μs*16=480μsごとに減衰させる
uint8_t icntr;                        // チャタリング防止カウンタ(32*255=8.1ms)
uint8_t nPlay=2;                      // 演奏回数(初回は2回演奏)

uint16_t v,v1,v2,v3, u,u1,u2;          // 振幅とその合算値
uint16_t E,E1,E2;                     // 包絡
uint16_t pW1,pW2,pW3, sw1,sw2,sw3;    // 波形ポインタとサンプリングステップ幅
uint8_t note1,note2;                  // 楽譜データDO|L4

hw_timer_t * timerA = NULL;//スピーカー用
boolean timer_flag = false;
float vol = 0.0;
int i = 0.0;
void IRAM_ATTR onTimerA() {
  timer_flag = true;
}
void setup() {
  Serial.begin(115200);
  float wmax = 255;
  for (int i = 0; i < 256; i++) {
    W[i] = (int)(wmax - (cos(2 * PI * i/255) + 1)/2*wmax);
    Serial.print (W[i]);
    Serial.print (",");
  }
  timerA = timerBegin(0, 40, true);//カウント時間は2マイクロ秒
  timerAttachInterrupt(timerA, &onTimerA, true);
  timerAlarmWrite(timerA, 16, true);//32us
  timerAlarmEnable(timerA);
  delay(1000);
}
 
void loop() {
  if(timer_flag){
//#if defined(SINE_WAVE) && (TRACK==2)//---------------------------------------------------------
    if(nPlay>0){
    if(--cntr==0){
      cntr=CNT;                       // 32us*(1953*120/Tempo)=62.5ms
      if(--len1==0){//大きい値から処理していく
        note1=pgm_read_byte(&part1[p1++]);  //mymelo.hにある楽譜データpart1の次のデータを取得
        if(note1==0){                 // part1終了!!
          nPlay--;                    // 演奏回数
          p1=p2=0;                    // 楽譜先頭
          note1=note2=0;
          len1=31; len2=32;           // 初期ディレイ(62.5ms*32=2s)
        }else{//波形生成用のデータを抽出
          len1=len[note1>>5];         // 音符は上位3ビット
          sw1=SW[note1&=0x1f];  pW1=0;// 音は下位5ビット
          E1=Nc<<7;                   // 初めは最大振幅(256)
          sw3=sw1+10; pW3=0;          // わずか周波数をずらす
        }
      }
      //-----------------------------------------
      if(--len2==0){
        note2=pgm_read_byte(&part2[p2++]);  // part2の次のデータ
        if(note2==0)  p2--;           // 0ならPart2の演奏終了
        else{
          len2=len[note2>>5];         // 音符は上位3ビット
          sw2=SW[note2&=0x1f];  pW2=0;// 音は下位5ビット
          E2=Nc<<7;                   // 初めは最大振幅
        }
      }
      //-----------------------------------------
    }
    //u1=0; v1=v3=0;
    u1=u2=0;  v1=v2=v3=0;             //初期化
    if(note1>1){                      // part1の振幅を加算
      E=(Nc<<7)-E1+128;//(この段階ではEは128では?)
      
      u1=(uint16_t)pgm_read_byte(&W[(uint8_t)(E>>9)]);  
      u1-=(u1>>5);
      
      x=(pW1+=sw1)>>8;  
      y=(pW1+E)>>8;
      v1=(uint16_t)pgm_read_byte(&W[x])+(uint16_t)pgm_read_byte(&W[y]);
      
      x=(pW3+=sw3)>>8;  
      y=(pW3+E)>>8;
      
      v3=(uint16_t)pgm_read_byte(&W[x])+(uint16_t)pgm_read_byte(&W[y]);  
    }else{  v1=v3=255;  u1=127; }     // 休符
//-----------------------------------------
    if(note2>1){                      // part2の振幅を加算
      E=(Nc<<7)-E2+128;
      u2=(uint16_t)pgm_read_byte(&W[(uint8_t)(E>>9)]);  u2-=(u2>>5);
      x=(pW2+=sw2)>>8;  y=(pW2+E)>>8;
      v2=(uint16_t)pgm_read_byte(&W[x])+(uint16_t)pgm_read_byte(&W[y]);
    }else{  v2=255; u2=127; }         // 休符
    v=v1+((v2+v3)>>1)+2;  u=(u1<<1)+u2+u1;
//-----------------------------------------
    dacWrite(25,(v-u)>>2);
    dacWrite(26,(v-u)>>2);
  }
  if(icntr>0) icntr--;
  if(--decayTimer==0){ E1-=(E1>>5); E2-=(E2>>5);} // 32us*256=8.192ms毎に包絡減衰
  dacWrite(25,32*F_CPU/8/1000000);
  dacWrite(26,32*F_CPU/8/1000000);
  }//timer
}
